## conf/bblayers.conf.sample
```bitbake
# POKY_BBLAYERS_CONF_VERSION is increased each time build/conf/bblayers.conf
# changes incompatibly
POKY_BBLAYERS_CONF_VERSION = "2"

BBPATH = "${TOPDIR}"
BBFILES ?= ""

BBLAYERS ?= " \
    ${TOPDIR}/../sources/poky/meta \
    ${TOPDIR}/../sources/poky/meta-poky \
    ${TOPDIR}/../sources/meta-droneOS \
    ${TOPDIR}/../sources/meta-nodejs \
    ${TOPDIR}/../sources/meta-nodejs-contrib \
    ${TOPDIR}/../sources/meta-openembedded/meta-oe \
    ${TOPDIR}/../sources/meta-openembedded/meta-filesystems \
    ${TOPDIR}/../sources/meta-openembedded/meta-multimedia \
    ${TOPDIR}/../sources/meta-openembedded/meta-networking \
    ${TOPDIR}/../sources/meta-openembedded/meta-python \
    ${TOPDIR}/../sources/meta-qt5 \
    ${TOPDIR}/../sources/meta-qt5-extra \
    ${TOPDIR}/../sources/meta-raspberrypi \
    ${TOPDIR}/../sources/meta-swupdate \
    ${TOPDIR}/../sources/poky \
  "
BBLAYERS_NON_REMOVABLE ?= " \
    ${TOPDIR}/../sources/poky/meta \
    ${TOPDIR}/../sources/poky/meta-poky \
  "
```

## conf/distro/poky-droneOS-systemd.conf
```bitbake
# droneOS distro

DISTRO = "poky-droneOS-systemd"

# Name, as it appears in startup banner:
DISTRO_NAME = "poky-droneOS-systemd"
DISTRO_VERSION = "1.0-${DATE}"
DISTRO_CODENAME = ""

MAINTAINER = "meta-droneOS"

TARGET_VENDOR = "-poky"

LOCALCONF_VERSION = "1"
LAYER_CONF_VERSION ?= "6"

# Image name/software version can be externally set by ${BUILDNAME}
# If not set, then set default name: ${USER}${DATETIME}
# Note: Immediate expansion here, since DATETIME will change as it is re-expanded during recipe parsing
DEFAULT_BUILDNAME := "${USER}${DATETIME}"
BUILDNAME := "${@d.getVar('BUILDNAME', True) or d.getVar('DEFAULT_BUILDNAME', True)}"

VIRTUAL-RUNTIME_init_manager = "systemd"
VIRTUAL-RUNTIME_initscripts = ""

DISTRO_FEATURES_DEFAULT = "alsa argp bluetooth bluez5 ext2 largefile opengl pam systemd usbgadget usbhost wayland wifi xattr"
DISTRO_FEATURES_BACKFILL_CONSIDERED = "sysvinit"

# Omit "weak" dependencies (e.g. RRECOMMENDS packages) to keep rootfs size small
NO_RECOMMENDATIONS = "1"
# Note: rpm package class does not respect NO_RECOMMENDATIONS setting (bitbake bug?)
#       Use ipk (or deb) package class instead:
PACKAGE_CLASSES = "package_ipk"

PREFERRED_PROVIDER_virtual/libgles1 = ""
PREFERRED_PROVIDER_virtual/libgles2 = "gles-user-module"
PREFERRED_PROVIDER_virtual/egl = "libegl"
PREFERRED_PROVIDER_virtual/libgl = ""
PREFERRED_PROVIDER_virtual/mesa = "mesa"
PREFERRED_PROVIDER_libgbm = "libgbm"
PREFERRED_PROVIDER_libgbm-dev = "libgbm"

PREFERRED_PROVIDER_virtual/arm-oe-linux-gnueabi-depmod ?= "kmod-cross"
PREFERRED_PROVIDER_udev ?= "systemd"
PREFERRED_PROVIDER_udev-utils ?= "systemd"
PREFERRED_PROVIDER_node-state-manager ?= "node-state-manager"

PREFERRED_PROVIDER_jpeg ?= "jpeg"
PREFERRED_PROVIDER_jpeg-native ?= "jpeg-native"

POKYQEMUDEPS = "${@bb.utils.contains("INCOMPATIBLE_LICENSE", "GPLv3", "", "packagegroup-core-device-devel",d)}"
DISTRO_EXTRA_RDEPENDS_append_qemuarm = " ${POKYQEMUDEPS}"
DISTRO_EXTRA_RDEPENDS_append_qemux86 = " ${POKYQEMUDEPS}"
DISTRO_EXTRA_RDEPENDS_append_qemux86-64 = " ${POKYQEMUDEPS}"
DISTRO_EXTRA_RDEPENDS_append_vexpressa9 = " ${POKYQEMUDEPS}"

QEMU_TARGETS ?= "arm i386 x86_64"

PREMIRRORS ??= "\
        bzr://.*/.*   http://downloads.yoctoproject.org/mirror/sources/ \n \
        cvs://.*/.*   http://downloads.yoctoproject.org/mirror/sources/ \n \
        git://.*/.*   http://downloads.yoctoproject.org/mirror/sources/ \n \
        gitsm://.*/.* http://downloads.yoctoproject.org/mirror/sources/ \n \
        hg://.*/.*    http://downloads.yoctoproject.org/mirror/sources/ \n \
        osc://.*/.*   http://downloads.yoctoproject.org/mirror/sources/ \n \
        p4://.*/.*    http://downloads.yoctoproject.org/mirror/sources/ \n \
        svn://.*/.*   http://downloads.yoctoproject.org/mirror/sources/ \n \
               "

MIRRORS =+ "\
        ftp://.*/.*   http://downloads.yoctoproject.org/mirror/sources/ \n \
        http://.*/.*  http://downloads.yoctoproject.org/mirror/sources/ \n \
        https://.*/.* http://downloads.yoctoproject.org/mirror/sources/ \n \
           "

# The CONNECTIVITY_CHECK_URI's are used to test whether we can succesfully
# fetch from the network (and warn you if not). To disable the test set
# the variable to be empty.
# Git example url: git://git.yoctoproject.org/yocto-firewall-test;protocol=git;rev=HEAD
CONNECTIVITY_CHECK_URIS ?= " \
             https://eula-downloads.yoctoproject.org/index.php \
                           "

# Ensure tmpdir is build/tmp, not build/tmp-glibc:
TCLIBCAPPEND = ""

# Default hash policy for distro
BB_SIGNATURE_HANDLER ?= 'OEBasicHash'

# OELAYOUT_ABI allows us to notify users when the format of TMPDIR changes in
# an incompatible way. Such changes should usually be detailed in the commit
# that breaks the format and have been previously discussed on the mailing list
# with general agreement from the core team.
#
#OELAYOUT_ABI = "8"

# add poky sanity bbclass
INHERIT += "poky-sanity"

# QA check settings - a little stricter than the OE-Core defaults
WARN_QA = "textrel files-invalid incompatible-license xorg-driver-abi libdir \
           unknown-configure-option build-deps"
ERROR_QA = "dev-so debug-deps dev-deps debug-files arch pkgconfig la perms \
            useless-rpaths rpaths staticdev ldflags pkgvarcheck already-stripped \
            compile-host-path dep-cmp installed-vs-shipped install-host-path \
            packages-list perm-config perm-line perm-link pkgv-undefined \
            pn-overrides split-strip var-undefined version-going-backwards"
```

## conf/layer.conf
```bitbake
# We have a conf and classes directory, append to BBPATH
BBPATH .= ":${LAYERDIR}"

# We have a recipes directory, add to BBFILES
BBFILES += "${LAYERDIR}/recipes*/*/*.bb \
            ${LAYERDIR}/recipes*/*/*.bbappend \
            ${LAYERDIR}/images/*.bb \
"

BBFILE_COLLECTIONS += "droneOS"
BBFILE_PATTERN_droneOS := "^${LAYERDIR}/"
BBFILE_PRIORITY_droneOS = "8"
```

## conf/local.conf.sample
```bitbake
#
# This file is your local configuration file and is where all local user settings
# are placed. The comments in this file give some guide to the options a new user
# to the system might want to change but pretty much any configuration option can
# be set in this file. More adventurous users can look at local.conf.extended
# which contains other examples of configuration which can be placed in this file
# but new users likely won't need any of them initially.
#
# Lines starting with the '#' character are commented out and in some cases the
# default values are provided as comments to show people example syntax. Enabling
# the option is a question of removing the # character and making any change to the
# variable as required.

#
# Parallelism Options
#
# These two options control how much parallelism BitBake should use. The first
# option determines how many tasks bitbake should run in parallel:
#
BB_NUMBER_THREADS ?= "${@oe.utils.cpu_count()}"
#
# The second option controls how many processes make should run in parallel when
# running compile tasks:
#
PARALLEL_MAKE ?= "-j ${@oe.utils.cpu_count()}"
#
# For a quad-core machine, BB_NUMBER_THREADS = "4", PARALLEL_MAKE = "-j 4" would
# be appropriate for example.

LICENSE_FLAGS_WHITELIST = "commercial"

DISTRO_FEATURES = "ext2 pam opengl usbhost ${DISTRO_FEATURES_LIBC}"

DISTRO_FEATURES_BACKFILL_CONSIDERED += "pulseaudio"

PREFERRED_PROVIDER_jpeg = "libjpeg-turbo"
PREFERRED_PROVIDER_jpeg-native = "libjpeg-turbo-native"

PREFERRED_PROVIDER_udev = "eudev"
VIRTUAL-RUNTIME_init_manager = "sysvinit"

MACHINE_FEATURES_remove = "apm"

IMAGE_FSTYPES = "tar.xz"

PREFERRED_VERSION_linux-raspberrypi = "4.9.%"

MACHINE = "raspberrypi2"

#
# Where to place downloads
#
# During a first build the system will download many different source code tarballs
# from various upstream projects. This can take a while, particularly if your network
# connection is slow. These are all stored in DL_DIR. When wiping and rebuilding you
# can preserve this directory to speed up this part of subsequent builds. This directory
# is safe to share between multiple builds on the same machine too.
#
# The default is a downloads directory under TOPDIR which is the build directory.
#
DL_DIR ?= "/work/downloads"

#
# Where to place shared-state files
#
# BitBake has the capability to accelerate builds based on previously built output.
# This is done using "shared state" files which can be thought of as cache objects
# and this option determines where those files are placed.
#
# You can wipe out TMPDIR leaving this directory intact and the build would regenerate
# from these files if no changes were made to the configuration. If changes were made
# to the configuration, only shared state files where the state was still valid would
# be used (done using checksums).
#
# The default is a sstate-cache directory under TOPDIR.
#
SSTATE_DIR ?= "/work/sstate-cache-droneOS"

#
# Where to place the build output
#
# This option specifies where the bulk of the building work should be done and
# where BitBake should place its temporary files and output. Keep in mind that
# this includes the extraction and compilation of many applications and the toolchain
# which can use Gigabytes of hard disk space.
#
# The default is a tmp directory under TOPDIR.
#
TMPDIR = "${TOPDIR}/tmp"

DISTRO ?= "poky-droneOS-systemd"

#
# Package Management configuration
#
# This variable lists which packaging formats to enable. Multiple package backends
# can be enabled at once and the first item listed in the variable will be used
# to generate the root filesystems.
# Options are:
#  - 'package_deb' for debian style deb files
#  - 'package_ipk' for ipk files are used by opkg (a debian style embedded package manager)
#  - 'package_rpm' for rpm style packages
# E.g.: PACKAGE_CLASSES ?= "package_rpm package_deb package_ipk"
# We default to rpm:
PACKAGE_CLASSES ?= "package_ipk"

ENABLE_UART = "1"
ENABLE_RPI3_SERIAL_CONSOLE = "1"

# i686 or x86_64
SDKMACHINE = "x86_64"

#EXTRA_IMAGE_FEATURES = "debug-tweaks"
INHERIT += "extrausers"
EXTRA_USERS_PARAMS = "usermod -P changeme root; "

USER_CLASSES = "image-mklibs image-prelink"

PATCHRESOLVE = "noop"

RM_OLD_IMAGE = "1"

INHERIT += "rm_work"

CONF_VERSION = "1"

#
# Disk Space Monitoring during the build
#
# Monitor the disk space during the build. If there is less that 1GB of space or less
# than 100K inodes in any key build location (TMPDIR, DL_DIR, SSTATE_DIR), gracefully
# shutdown the build. If there is less that 100MB or 1K inodes, perform a hard abort
# of the build. The reason for this is that running completely out of space can corrupt
# files and damages the build in ways which may not be easily recoverable.
BB_DISKMON_DIRS = "\
    STOPTASKS,${TMPDIR},1G,100K \
    STOPTASKS,${DL_DIR},1G,100K \
    STOPTASKS,${SSTATE_DIR},1G,100K \
    ABORT,${TMPDIR},100M,1K \
    ABORT,${DL_DIR},100M,1K \
    ABORT,${SSTATE_DIR},100M,1K"


LICENSE_FLAGS_WHITELIST = "commercial"
USE_GSTREAMER_1_00="1"

# Include static library in SDK
SDKIMAGE_FEATURES_append = " staticdev-pkgs"
```
